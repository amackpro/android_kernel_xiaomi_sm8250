/* Copyright (c) 2018-2019, The Linux Foundation. All rights reserved.
 *
 * This program is free software; you can redistribute it and/or modify
 * it under the terms of the GNU General Public License version 2 and
 * only version 2 as published by the Free Software Foundation.
 *
 * This program is distributed in the hope that it will be useful,
 * but WITHOUT ANY WARRANTY; without even the implied warranty of
 * MERCHANTABILITY or FITNESS FOR A PARTICULAR PURPOSE.  See the
 * GNU General Public License for more details.
 */

qcom,munch {
	/* j1 jeita, step charge and other important charging parameters */
	qcom,fastchg-current-ma = <12400>;
	qcom,jeita-fcc-ranges = <0  50    2200000
				51  434  11000000
				435 459  2200000>;
	qcom,jeita-fv-ranges = <0  50   4450000
				51  434  4480000
				435 459  4090000>;
	qcom,step-chg-ranges = <3000000  3349000  11000000
				4201000  4300000  8220000
				4301000  4400000  6900000
				4401000  4480000  2580000>;
	qcom,cold-step-chg-ranges = <3000000  4199000  1000000
				4200000  4450000  660000>;
	qcom,ocv-based-step-chg;
	qcom,taper-fcc;
	qcom,use-bq-pump;
	qcom,use-ext-gauge;
	qcom,max-voltage-uv = <4490000>;//for fv
	qcom,batt-id-kohm = <100>;
	qcom,battery-type = "L11R_profile";
};
